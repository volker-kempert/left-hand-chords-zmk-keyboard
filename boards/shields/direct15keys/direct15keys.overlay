/ {
	chosen {
		zmk,kscan = &default_kscan;
	};


	default_kscan: kscan {
		compatible = "zmk,kscan-gpio-direct";

		/* switches are connected to the GND if pressed --> pull up and low active */
		input-gpios
            = <&gpio0 8  (GPIO_ACTIVE_LOW | GPIO_PULL_UP)>  /* D0 */
			, <&gpio0 6  (GPIO_ACTIVE_LOW | GPIO_PULL_UP)>	/* D1 */
			, <&gpio0 17 (GPIO_ACTIVE_LOW | GPIO_PULL_UP)> 	/* D2 */
			, <&gpio0 20 (GPIO_ACTIVE_LOW | GPIO_PULL_UP)>	/* D4/A6 */
			, <&gpio0 22 (GPIO_ACTIVE_LOW | GPIO_PULL_UP)>	/* D5  */
            , <&gpio0 24 (GPIO_ACTIVE_LOW | GPIO_PULL_UP)>	/* D6/A7 */
			, <&gpio1 0  (GPIO_ACTIVE_LOW | GPIO_PULL_UP)>
			, <&gpio0 11 (GPIO_ACTIVE_LOW | GPIO_PULL_UP)>
			, <&gpio1 4  (GPIO_ACTIVE_LOW | GPIO_PULL_UP)>
			, <&gpio1 6  (GPIO_ACTIVE_LOW | GPIO_PULL_UP)>
            , <&gpio0 9  (GPIO_ACTIVE_LOW | GPIO_PULL_UP)>
			, <&gpio0 10 (GPIO_ACTIVE_LOW | GPIO_PULL_UP)>
            , <&gpio1 11 (GPIO_ACTIVE_LOW | GPIO_PULL_UP)>
			, <&gpio1 13 (GPIO_ACTIVE_LOW | GPIO_PULL_UP)>
            , <&gpio1 15 (GPIO_ACTIVE_LOW | GPIO_PULL_UP)>
			;

	};


};

