## boards/shields/direct15keys/Kconfig.defconfig
```kconfig
if SHIELD_direct15keys

config ZMK_KEYBOARD_NAME
    default "single-15-keys"

endif
```

## boards/shields/m4x3_t3_no-diode/Kconfig.defconfig
```kconfig
if SHIELD_M4X3_T3_NODIODE

config ZMK_KEYBOARD_NAME
    default "single-15-keys"

endif
```

## boards/shields/m4x3_t3_no-diode/Kconfig.shield
```kconfig
config SHIELD_M4X3_T3_NODIODE
    def_bool $(shields_list_contains, M4x3T3NoDiode )
```

## config/boards/shields/direct15keys/Kconfig.defconfig
```kconfig
if SHIELD_direct15keys

config ZMK_KEYBOARD_NAME
    default "zmk-kbd-vkrt"

if ZMK_DISPLAY

config I2C
    default y

config SSD1306
    default y

endif # ZMK_DISPLAY

if LVGL

config LV_Z_VDB_SIZE
    default 64

config LV_DPI_DEF
    default 148

config LV_Z_BITS_PER_PIXEL
    default 1

choice LV_COLOR_DEPTH
    default LV_COLOR_DEPTH_1
endchoice

endif # LVGL

endif # SHIELD_direct15keys
```
